#include <SPI.h>
#include <RadioLib.h>

#define LORA_CLK     12
#define LORA_MISO    13
#define LORA_MOSI    11
#define LORA_CS      10
#define LORA_RST     14
#define LORA_BUSY    9
#define LORA_DIO9    16

#define RGB_DATA_PIN 38
#define RGB_PWR_PIN  39

#define ID 0

LR1121 radio = new Module(LORA_CS, LORA_DIO9, LORA_RST, LORA_BUSY);

volatile bool packetReceived = false;

void setFlag() {
    packetReceived = true;
}

struct SatellitePayload {
    uint8_t identifier;
    uint32_t messageID;
    uint32_t telemetry;
    uint32_t telemetry2;
};

struct AckPayload {
    uint8_t packetType;
    uint8_t identifier;
    uint8_t targetSF;
    uint8_t targetBW;
};

// Initialized modem config to this
uint8_t currentSF = 10;
float currentBW = 250;

volatile uint8_t goodPacketCount = 0;
volatile long long lastPacketTime = 0;
volatile long int count;

SatellitePayload rxData;
AckPayload ackData;

const double dopplerRates[] = {-2.2256, -2.2511, -2.3024, -2.3544, -2.4069, -2.4601, -2.5139, -2.5683,
  -2.6234, -2.6791, -2.7355, -2.7926, -2.8504, -2.9088, -2.9680, -3.0279,
  -3.0886, -3.1500, -3.2122, -3.2752, -3.3389, -3.4035, -3.4689, -3.5351,
  -3.6022, -3.6701, -3.7389, -3.8087, -3.8793, -3.9509, -4.0234, -4.0969,
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  -2.5683, -2.5139, -2.4601, -2.4069, -2.3544, -2.3024, -2.2766};

const double distances[] = { 2153054.44, 2145841.37, 2138629.03, 2131417.46, 2124206.65, 2116996.64,
  2109787.43, 2102579.04, 2095371.50, 2088164.81, 2080959.01, 2073754.10,
  2066550.11, 2059347.05, 2052144.95, 2044943.81, 2037743.68, 2030544.55,
  2023346.46, 2016149.42, 2008953.45, 2001758.58, 1994564.82, 1987372.21,
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  2109787.43, 2116996.64, 2124206.65, 2131417.46, 2138629.03, 2145841.37
};

void setup() {
    Serial.begin(921600);
    pinMode(RGB_DATA_PIN, OUTPUT);
    digitalWrite(RGB_PWR_PIN, HIGH);

    SPI.begin(LORA_CLK, LORA_MISO, LORA_MOSI, LORA_CS);
    
    int state = radio.begin(
        915.0,       // Carrier Frequency (MHz)
        currentBW,   // Bandwidth (kHz)
        currentSF,   // Spreading Factor
        5,           // Coding Rate (4/5)
        0x12,        // Sync Word
        17           // TX Power (dBm)
    );
    
    state = radio.setTCXO(1.6);

    if (state != RADIOLIB_ERR_NONE) {
        while (true) {
            Serial.println("Configuration Failed!");
            neopixelWrite(RGB_DATA_PIN, 100, 0, 0); // Red-blue flashes on setup error, blocks initialization
            Serial.print("Error: ");
            Serial.println(state);
            neopixelWrite(RGB_DATA_PIN, 0, 0, 0);
            delay(10);
            neopixelWrite(RGB_DATA_PIN, 0, 100, 0);
            delay(200);
        }
    }

    radio.setPacketReceivedAction(setFlag);
    radio.startReceive();
    lastPacketTime = millis(); // Initialize time here to prevent startup errors
}

constexpr float TX_POWER_DBM = 22.0;
constexpr float TX_GAIN_DBI  = 2.0;
constexpr float RX_GAIN_DBI  = 3.0;
constexpr float RX_NOISE_FIGURE_DB = 3.5;
constexpr float CARRIER_FREQ_MHZ = 915.0; // We can assume satellite freq is centred at this because Doppler shift barely affects the FSPL

float requiredSNR(uint8_t sf) {
    switch (sf) {
        case 7:  return -7.5;
        case 8:  return -10.0;
        case 9:  return -12.5;
        case 10: return -15.0;
        case 11: return -17.5;
        case 12: return -20.0;
        default: return -20.0;
    }
}

struct LinkConfig {
    uint8_t sf;
    float bw;
};
const LinkConfig operationalModes[] = {
    {7,  500.0}, // Tier 0 (Fastest)
    {9,  250.0}, // Tier 1
    {10, 250.0} // Tier 2 (Most Resilient)
};
const uint8_t totalModes = 3;
uint8_t activeModeIdx = 2;

// Analytical assessment function to return diagnostic failure flags
int evaluatelinkConstraints(uint32_t secondIdx) {
    if (secondIdx >= 559) return -1; // out of bounds

    double currentRate = abs(dopplerRates[secondIdx]);
    double currentDistance = distances[secondIdx];

    // Doppler Rate Assessment
    double bwHz = currentBW * 1000.0;
    double dopplerLimit = 0.25 * (pow(bwHz, 2) / (double)(1ULL << (2 * currentSF)));
    if (currentRate > dopplerLimit) {
        return 2; // Fail doppler rate assessment 
    }

    // Link Budget Assessment
    double expectedSNR = getSimulatedSNR(secondIdx, currentBW);
    float reqSNR = requiredSNR(currentSF);

    if (expectedSNR < reqSNR) {
        return 1; // Fail link budget
    }

    return 0; // everything passes
}

//Get simulated snr and rssi
float calculateFSPL(double distanceMeters){
    float distanceKm = distanceMeters / 1000.0;

    return 32.44 + 20.0 * log10(distanceKm) + 20.0 * log10(CARRIER_FREQ_MHZ);
}

float getSimulatedRSSI(uint32_t secondIdx){
    if (secondIdx >= 559)
        return -150.0;

    float fspl = calculateFSPL(distances[secondIdx]);

    return TX_POWER_DBM + TX_GAIN_DBI + RX_GAIN_DBI - fspl;
}

double getSimulatedSNR(uint32_t secondIdx, double bwkHz){
    double rssi = getSimulatedRSSI(secondIdx);

    double noiseFloor = -174.0 + 10.0 * log10(bwkHz * 1000.0) + RX_NOISE_FIGURE_DB;

    return rssi - noiseFloor;
}

LinkConfig react(bool packet, float snr, float rssi) {
    // Compute the available SNR margin
    float margin = snr - requiredSNR(currentSF);

    // DOWNGRADE if the current configuration is becoming unreliable
    if (!packet){
        goodPacketCount = 0;
        activeModeIdx = 2; // doppler rate is not a problem for sf 10 / 250 khz, directly switch to it to solve link issues
    } else if (margin < 2.0f || rssi < -127.0f) { // if for some reason there is continuous corruption, try to loop through all combos.
        goodPacketCount = 0;
        if (activeModeIdx < totalModes - 1) {
            activeModeIdx++;
        }
    } else if (margin > 5.0f && rssi > -122.0f) {
        // UPGRADE only if there is a sufficient spare margin
        goodPacketCount++;
        if (goodPacketCount >= 3){
            if (activeModeIdx > 0) {
                activeModeIdx--;
                goodPacketCount = 0;
            }
        }
    } else {
        goodPacketCount = 0;
    }

    return operationalModes[activeModeIdx];
}

void sendAdaptivePacket(bool packet, float snr, float rssi){
    LinkConfig recommendedMode = react(packet, snr, rssi);

    // send the adaptive packet
    ackData.packetType = 0x01;
    ackData.identifier = ID;
    ackData.targetSF = recommendedMode.sf;
    ackData.targetBW = recommendedMode.bw;
                
    radio.transmit((uint8_t*)&ackData, sizeof(ackData));

    // set new sf and bw
    radio.setBandwidth(recommendedMode.bw);
    radio.setSpreadingFactor(recommendedMode.sf);
}

void loop() {
    if (packetReceived) {
        packetReceived = false;

        int state = radio.readData((uint8_t*)&rxData, sizeof(rxData));

        radio.startReceive();
        if (state == RADIOLIB_ERR_NONE && rxData.identifier == 1) {
            uint32_t t = rxData.messageID;
            int status = evaluatelinkConstraints(t);
            if (status == 0){
                // passes link constraints
                float snr = getSimulatedSNR(t, currentBW);
                float rssi = getSimulatedRSSI(t);
                char json[128];
                snprintf(json, sizeof(json),
                "{\"type\":\"PACKET\",\"ID\":%d,\"data1\":%lu,\"data2\":%lu,\"status\":%i}",
                rxData.messageID,
                rxData.telemetry,
                rxData.telemetry2,
                status);
                Serial.println(json);
                sendAdaptivePacket(true, snr, rssi);
            } else if (status == 1){
                // force link err
                neopixelWrite(RGB_DATA_PIN, 50, 0, 50); // Steady purple signifies connection loss
                delay(25);
                neopixelWrite(RGB_DATA_PIN, 0, 0, 0);
                char json[128];
                snprintf(json, sizeof(json),
                "{\"type\":\"LINK_ERR\",\"ID\":%d,\"data1\":%lu,\"data2\":%lu,\"status\":%i}", -2, millis(), rxData.messageID, status);
                Serial.println(json);
                sendAdaptivePacket(false, -1, -1);
            } else if (status == 2){
                // force crc failure
                lastPacketTime = millis();
                neopixelWrite(RGB_DATA_PIN, 50, 0, 0); // Red flash for mock CRC failure
                delay(25);
                neopixelWrite(RGB_DATA_PIN, 0, 0, 0);
                char json[128];
                snprintf(json, sizeof(json),
                "{\"type\":\"DATA_ERR\",\"ID\":%d,\"data1\":%lu,\"data2\":%lu,\"status\":%i}", -1, millis(), 0, status);
                Serial.println(json);
                sendAdaptivePacket(false, -1, -1);
            }
        } else {
            lastPacketTime = millis();
            neopixelWrite(RGB_DATA_PIN, 50, 0, 0); // Red flash for CRC failure
            delay(25);
            neopixelWrite(RGB_DATA_PIN, 0, 0, 0);
            char json[128];
            snprintf(json, sizeof(json),
            "{\"type\":\"DATA_ERR\",\"ID\":%d,\"data1\":%lu,\"data2\":%lu,\"snr\":%.2f}", -1, millis(), 0, 0.00);
            Serial.println(json);
        }
    }

    // for some reason, a packet was not received
    if (millis() - lastPacketTime > 1000) {
        neopixelWrite(RGB_DATA_PIN, 50, 0, 50); // Steady purple signifies connection loss
        delay(25);
        neopixelWrite(RGB_DATA_PIN, 0, 0, 0);
        char json[128];
        snprintf(json, sizeof(json),
        "{\"type\":\"LINK_ERR\",\"ID\":%d,\"data1\":%lu,\"data2\":%lu,\"snr\":%.2f}", -2, millis(), 0, 0.00);
        activeModeIdx = 2; 
        goodPacketCount = 0;
        currentSF = operationalModes[activeModeIdx].sf;
        currentBW = operationalModes[activeModeIdx].bw;
        
        radio.setBandwidth(currentBW);
        radio.setSpreadingFactor(currentSF);
        radio.startReceive();
    }
}