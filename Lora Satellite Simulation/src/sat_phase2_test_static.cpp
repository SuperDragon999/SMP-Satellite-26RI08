#include <SPI.h>
#include <RadioLib.h>
#include "touch_sensor.h"

#define LORA_CLK     12
#define LORA_MISO    13
#define LORA_MOSI    11
#define LORA_CS      10
#define LORA_RST     15
#define LORA_BUSY    9
#define LORA_DIO9    16

#define RGB_DATA_PIN 38
#define RGB_PWR_PIN  39

#define ID 1

struct SatellitePayload {
    uint8_t identifier;
    uint32_t messageID;
    uint32_t telemetry;
    uint32_t telemetry2;
};

SatellitePayload txData;

LR1121 radio = new Module(LORA_CS, LORA_DIO9, LORA_RST, LORA_BUSY);

const double dopplerOffsets[] = { 22012.1800, 22013.5751, 22014.9518, 22016.3100, 22017.6496, 22018.9704,
 22020.2723, 22021.5553, 22022.8192, 22024.0639, 22025.2892, 22026.4951,
 22027.6815, 22028.8481, 22029.9949, 22031.1218, 22032.2285, 22033.3151,
 22034.3813, 22035.4271, 22036.4522, 22037.4566, 22038.4401, 22039.4025,
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 -22016.3100, -22014.9518, -22013.5751 };

const int numSteps = 800;
unsigned long passStartTime;

uint8_t satSF = 12;
float satBW = 250;

void setup() {
    Serial.begin(921600);
    pinMode(RGB_DATA_PIN, OUTPUT);
    pinMode(RGB_PWR_PIN, OUTPUT);
    digitalWrite(RGB_PWR_PIN, HIGH);
    
    delay(100);    
    SPI.begin(LORA_CLK, LORA_MISO, LORA_MOSI);

    radio.tcxoVoltage = 1.6;
    // Initialization signature for RadioLib LR1121 standard syntax
    int state = radio.begin(
        915.0,       // Center Frequency (MHz)
        satBW,       // Bandwidth (kHz)
        satSF,       // Spreading Factor
        5,           // Coding Rate (4/5)
        0x12,        // Sync Word
        22,          // Output Power (dBm)
        8            // Preamble length
    );
    
    if (state != RADIOLIB_ERR_NONE) {
        while (true) {
            neopixelWrite(RGB_DATA_PIN, 100, 0, 0); // Solid red blocks execution on setup error
            Serial.println(state);
            delay(200);
            neopixelWrite(RGB_DATA_PIN, 0, 0, 0);
            delay(200);
        }
    }
    
    passStartTime = millis();
}

volatile long long loopStart;
void loop() {
    loopStart = millis();
    unsigned long elapsed = (millis() - passStartTime) / 1000;
    
    int index = elapsed;
    if (index >= 800) index = 799; // Absolute safety boundary guard
    
    radio.standby(); // clears any stuck rx registers

    double currentOffset = dopplerOffsets[index];
    double compensatedFreq = 915.0 + (currentOffset / 1000000.0);
    radio.setFrequency((float)compensatedFreq);
    radio.standby();

    // 1. Compile system frame payload structures
    txData.identifier = ID;
    txData.messageID = index;
    txData.telemetry = (uint32_t)getReading();
    txData.telemetry2 = (uint32_t)getReading2();
    
    // 2. Dispatch telemetry
    unsigned long txStartTime = micros();
    int txState = radio.transmit((uint8_t*)&txData, sizeof(txData));

    while(digitalRead(LORA_BUSY) == HIGH) {
        yield();
    }
    unsigned long txEndTime = micros();

    unsigned long toa = txEndTime - txStartTime;

    if (txState == RADIOLIB_ERR_NONE) {
        neopixelWrite(RGB_DATA_PIN, 0, 0, 20); // Blue indicates down-link transmission confirmed
        delay(20);
        neopixelWrite(RGB_DATA_PIN, 0, 0, 0);
        char json[128];
        snprintf(json, sizeof(json),
        "{\"ID\":%ld,\"time\":%lu}", index, toa);
        Serial.println(json);
    } else {
        neopixelWrite(RGB_DATA_PIN, 50, 0, 0);
        char json[128];
        snprintf(json, sizeof(json),
        "{\"ID\":%ld,\"time\":%lu}", -1L, millis()); //Failed packets give -1 as ID, and a unique timestamp using millis() to avoid duplicates
        Serial.println(json);
    }
    
    long long end = millis();
    if (end - loopStart <= 1000){
        delay(1000 - (end - loopStart));
    }
}