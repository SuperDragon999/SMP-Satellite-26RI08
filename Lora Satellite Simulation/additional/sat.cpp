#include <SPI.h>
#include <RadioLib.h>
#include "touch_sensor.h"

#define LORA_SCK     12
#define LORA_MISO    13
#define LORA_MOSI    11
#define LORA_SS      10
#define LORA_RST     9
#define LORA_BUSY    21
#define LORA_DIO1    8

#define RGB_DATA_PIN 38
#define RGB_PWR_PIN  39

#define ID 1

struct SatellitePayload {
    uint8_t identifier;
    uint32_t messageId;
    uint32_t telemetry;
    uint32_t telemetry2;
};

struct AckPayload {
    uint8_t packetType;
    uint8_t identifier;
    uint32_t messageId;
    uint8_t targetSF;
    uint8_t targetBWCode;
};

SatellitePayload txData;
AckPayload ackData;
LR1121 radio = new Module(LORA_SS, LORA_DIO1, LORA_RST, LORA_BUSY);

const float dopplerOffsets[] = { 22012.1799763 ,  22013.57509443,  22014.95180347,  22016.30999315,
  22017.6495519 ,  22018.97036681,  22020.27232361,  22021.55530663,
  22022.81919881,  22024.06388168,  22025.28923531,  22026.49513831,
  22027.68146781,  22028.84809943,  22029.99490726,  22031.12176383,
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 -22017.6495519 , -22016.30999315, -22014.95180347, -22013.57509443 };

const int numSteps = 800;
unsigned long passStartTime;

uint8_t satSF = 7;
float satBW = 125.0;
uint32_t count = 0;

void setup() {
    Serial.begin(921600);
    pinMode(RGB_DATA_PIN, OUTPUT);
    pinMode(RGB_PWR_PIN, OUTPUT);
    digitalWrite(RGB_PWR_PIN, HIGH);
    
    SPI.begin(LORA_SCK, LORA_MISO, LORA_MOSI, LORA_SS);
    
    // Initialization signature for RadioLib LR1121 standard syntax
    int state = radio.begin(
        915.0,       // Center Frequency (MHz)
        satBW,       // Bandwidth (kHz)
        satSF,       // Spreading Factor
        5,           // Coding Rate (4/5)
        0x12,        // Sync Word
        17           // Output Power (dBm)
    );
    
    if (state != RADIOLIB_ERR_NONE) {
        while (true) {
            neopixelWrite(RGB_DATA_PIN, 100, 0, 0); // Solid red blocks execution on setup error
            delay(200);
            neopixelWrite(RGB_DATA_PIN, 0, 0, 0);
            delay(200);
        }
    }

    // Initialization of internal TCXO required by Core1121 modules
    radio.setTCXO(1.6);
    
    passStartTime = millis();
}

volatile long long loopStart;
void loop() {
    loopStart = millis();
    unsigned long elapsed = (millis() - passStartTime) / 1000;
    
    int index = elapsed;
    if (index >= 800) index = 799; // Absolute safety boundary guard
    
    radio.standby(); // clears any stuck rx registers

    // 1. Calculate and adjust for physical kinematic orbit offsets
    float currentOffset = dopplerOffsets[index];
    float compensatedFreq = 915.0 + (currentOffset / 1000000.0);
    radio.setFrequency(compensatedFreq);

    // 2. Compile system frame payload structures
    txData.identifier = ID;
    txData.messageId = count++;
    txData.telemetry = 123;
    txData.telemetry2 = (uint32_t)getReading();

    neopixelWrite(RGB_DATA_PIN, 20, 20, 0); // Yellow flash indicates frame transmission sweep
    
    // 3. Dispatch telemetry burst
    int txState = radio.transmit((uint8_t*)&txData, sizeof(txData));
    
    if (txState == RADIOLIB_ERR_NONE) {
        neopixelWrite(RGB_DATA_PIN, 0, 0, 20); // Blue indicates down-link transmission confirmed
        
        // 4. Initialize critical timed receiver window to catch Ground Station tracking frame
        // A 300ms listening window prevents the state machine from locking up if an ACK disappears
        int rxState = radio.receive((uint8_t*)&ackData, sizeof(ackData), 300);
        
        if (rxState == RADIOLIB_ERR_NONE && ackData.packetType == 2 && ackData.messageId == txData.messageId) {
            neopixelWrite(RGB_DATA_PIN, 0, 20, 0); // Green confirms closed-loop link negotiation tracking active
            
            // Extract down-link command registers mapped out by the ground station
            satSF = ackData.targetSF;
            uint8_t bwCode = ackData.targetBWCode;
            
            if (bwCode == 0) satBW = 62.5;
            else if (bwCode == 1) satBW = 125.0;
            else if (bwCode == 2) satBW = 250.0;
            
            // Commit structural modifications to internal transceiver parameters
            radio.standby();
            radio.setBandwidth(satBW);
            radio.setSpreadingFactor(satSF);
        } else {
            neopixelWrite(RGB_DATA_PIN, 30, 0, 0); // Red flash warns of dropped tracking frame
        }
    } else {
        neopixelWrite(RGB_DATA_PIN, 50, 0, 0);
    }

    long long end = millis();
    if (end - loopStart <= 1000){
        delay(1000 - (end - loopStart));
    }
}